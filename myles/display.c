#include "display.h"
#include "pico/stdlib.h"
#include "hardware/spi.h"
#include "hardware/gpio.h"

// ---------------------------------------------------------------------------
// Low-level SPI helpers
// ---------------------------------------------------------------------------

void display_send_cmd(uint8_t cmd) {
    gpio_put(TFT_DC_PIN, 0);   // DC low = command
    gpio_put(TFT_CS_PIN, 0);   // CS active low
    spi_write_blocking(spi0, &cmd, 1);
    gpio_put(TFT_CS_PIN, 1);   // CS deassert
}

void display_send_data(uint8_t data) {
    gpio_put(TFT_DC_PIN, 1);   // DC high = data
    gpio_put(TFT_CS_PIN, 0);
    spi_write_blocking(spi0, &data, 1);
    gpio_put(TFT_CS_PIN, 1);
}

void display_send_data16(uint16_t data) {
    gpio_put(TFT_DC_PIN, 1);   // DC high = data
    gpio_put(TFT_CS_PIN, 0);
    uint8_t buf[2] = { (uint8_t)(data >> 8), (uint8_t)(data & 0xFF) };
    spi_write_blocking(spi0, buf, 2);
    gpio_put(TFT_CS_PIN, 1);
}

// ---------------------------------------------------------------------------
// Window setting
// ---------------------------------------------------------------------------

void display_set_window(uint16_t x0, uint16_t y0, uint16_t x1, uint16_t y1) {
    // Column Address Set (0x2A)
    display_send_cmd(0x2A);
    display_send_data((uint8_t)(x0 >> 8));
    display_send_data((uint8_t)(x0 & 0xFF));
    display_send_data((uint8_t)(x1 >> 8));
    display_send_data((uint8_t)(x1 & 0xFF));

    // Row Address Set (0x2B)
    display_send_cmd(0x2B);
    display_send_data((uint8_t)(y0 >> 8));
    display_send_data((uint8_t)(y0 & 0xFF));
    display_send_data((uint8_t)(y1 >> 8));
    display_send_data((uint8_t)(y1 & 0xFF));

    // Memory Write (0x2C) — prepare for pixel data
    display_send_cmd(0x2C);
}

// ---------------------------------------------------------------------------
// Drawing primitives
// ---------------------------------------------------------------------------

void display_draw_pixel(uint16_t x, uint16_t y, uint16_t color) {
    display_set_window(x, y, x, y);
    display_send_data16(color);
}

void display_fill_rect(uint16_t x, uint16_t y, uint16_t w, uint16_t h, uint16_t color) {
    display_set_window(x, y, x + w - 1, y + h - 1);

    uint8_t hi = (uint8_t)(color >> 8);
    uint8_t lo = (uint8_t)(color & 0xFF);

    gpio_put(TFT_DC_PIN, 1);   // DC high = data
    gpio_put(TFT_CS_PIN, 0);   // Hold CS low for entire burst
    for (uint32_t i = 0; i < (uint32_t)w * h; i++) {
        uint8_t buf[2] = { hi, lo };
        spi_write_blocking(spi0, buf, 2);
    }
    gpio_put(TFT_CS_PIN, 1);   // CS deassert
}

void display_draw_vline(uint16_t x, uint16_t y0, uint16_t y1, uint16_t color) {
    if (y0 > y1) {
        uint16_t tmp = y0;
        y0 = y1;
        y1 = tmp;
    }
    uint16_t len = y1 - y0 + 1;
    display_set_window(x, y0, x, y1);

    uint8_t hi = (uint8_t)(color >> 8);
    uint8_t lo = (uint8_t)(color & 0xFF);

    gpio_put(TFT_DC_PIN, 1);   // DC high = data
    gpio_put(TFT_CS_PIN, 0);   // Hold CS low for entire burst
    for (uint16_t i = 0; i < len; i++) {
        uint8_t buf[2] = { hi, lo };
        spi_write_blocking(spi0, buf, 2);
    }
    gpio_put(TFT_CS_PIN, 1);   // CS deassert
}

// ---------------------------------------------------------------------------
// Initialization
// ---------------------------------------------------------------------------

void display_init(void) {
    // --- SPI0 peripheral init at 62.5 MHz ---
    spi_init(spi0, 62500000);

    // Assign SPI0 function to MOSI and SCK pins
    gpio_set_function(TFT_MOSI_PIN, GPIO_FUNC_SPI);
    gpio_set_function(TFT_SCK_PIN,  GPIO_FUNC_SPI);

    // CS pin — manual GPIO control (not hardware CS)
    gpio_init(TFT_CS_PIN);
    gpio_set_dir(TFT_CS_PIN, GPIO_OUT);
    gpio_put(TFT_CS_PIN, 1);  // deasserted (active low)

    // DC pin — GPIO output
    gpio_init(TFT_DC_PIN);
    gpio_set_dir(TFT_DC_PIN, GPIO_OUT);
    gpio_put(TFT_DC_PIN, 0);

    // RESET pin — GPIO output
    gpio_init(TFT_RESET_PIN);
    gpio_set_dir(TFT_RESET_PIN, GPIO_OUT);

    // --- Hardware reset sequence ---
    gpio_put(TFT_RESET_PIN, 1);
    sleep_ms(10);
    gpio_put(TFT_RESET_PIN, 0);
    sleep_ms(10);
    gpio_put(TFT_RESET_PIN, 1);
    sleep_ms(150);

    // --- TFT controller init commands ---

    // Software Reset
    display_send_cmd(0x01);
    sleep_ms(150);

    // Sleep Out
    display_send_cmd(0x11);
    sleep_ms(150);

    // Pixel Format — 16-bit RGB565
    display_send_cmd(0x3A);
    display_send_data(0x55);

    // Memory Access Control — landscape (row/col exchange + column address order)
    display_send_cmd(0x36);
    display_send_data(0x28);

    // Display On
    display_send_cmd(0x29);

    // Clear screen to black
    display_fill_rect(0, 0, TFT_WIDTH, TFT_HEIGHT, COLOR_BLACK);
}

// ---------------------------------------------------------------------------
// 5x7 bitmap font — ASCII 0x20 (space) through 0x7E (~)
// Each character is 5 bytes; each byte is one column, LSB = top row.
// ---------------------------------------------------------------------------

static const uint8_t font[][5] = {
    {0x00,0x00,0x00,0x00,0x00}, // 0x20 ' '
    {0x00,0x00,0x5F,0x00,0x00}, // 0x21 '!'
    {0x00,0x07,0x00,0x07,0x00}, // 0x22 '"'
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    {0x08,0x04,0x08,0x10,0x08}, // 0x7E '~'
};

// ---------------------------------------------------------------------------
// Text rendering
// ---------------------------------------------------------------------------

void display_draw_char(uint16_t x, uint16_t y, char c, uint16_t color, uint16_t bg) {
    // Clamp to printable ASCII range
    if (c < 0x20 || c > 0x7E) {
        c = 0x20; // render as space for out-of-range characters
    }

    const uint8_t *glyph = font[(uint8_t)c - 0x20];

    // Set a 6×8 window (5 font columns + 1 spacing column, 7 rows + 1 spacing row)
    display_set_window(x, y, x + 5, y + 7);

    uint8_t hi_fg = (uint8_t)(color >> 8);
    uint8_t lo_fg = (uint8_t)(color & 0xFF);
    uint8_t hi_bg = (uint8_t)(bg >> 8);
    uint8_t lo_bg = (uint8_t)(bg & 0xFF);

    gpio_put(TFT_DC_PIN, 1);   // DC high = data
    gpio_put(TFT_CS_PIN, 0);   // Hold CS low for entire burst

    // The window is filled row-by-row (top to bottom, left to right)
    for (uint8_t row = 0; row < 8; row++) {
        for (uint8_t col = 0; col < 6; col++) {
            uint8_t buf[2];
            if (col < 5 && row < 7 && (glyph[col] & (1 << row))) {
                buf[0] = hi_fg;
                buf[1] = lo_fg;
            } else {
                buf[0] = hi_bg;
                buf[1] = lo_bg;
            }
            spi_write_blocking(spi0, buf, 2);
        }
    }

    gpio_put(TFT_CS_PIN, 1);   // CS deassert
}

void display_draw_string(uint16_t x, uint16_t y, const char *str, uint16_t color, uint16_t bg) {
    while (*str) {
        display_draw_char(x, y, *str, color, bg);
        x += 6; // 5 font pixels + 1 spacing pixel
        str++;
    }
}
